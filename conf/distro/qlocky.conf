## conf/distro/qlocky.conf
```bitbake
require conf/distro/poky.conf

DISTRO = "qlocky"
DISTRO_NAME = "Qlocky"
DISTRO_VERSION = "1.0"
DISTRO_CODENAME = "scarthgap"

MAINTAINER = "Qlocky Maintainers"


# https://docs.yoctoproject.org/3.2/ref-manual/ref-features.html#distro-features
DISTRO_FEATURES:append = " efi systemd weston wayland pam opengl"
DISTRO_FEATURES:remove = " x11 ptest"

INIT_MANAGER = "systemd"
```
