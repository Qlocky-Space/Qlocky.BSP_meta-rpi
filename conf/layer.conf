## conf/layer.conf
```bitbake
DESCRIPTION = "The main Qlocky layer"
HOMEPAGE = "https://github.com/Qlocky-Space"

# We have a conf and classes directory, add to BBPATH
BBPATH .= ":${LAYERDIR}"

# We have recipes-* directories, add to BBFILES
BBFILES += "${LAYERDIR}/recipes-*/*/*.bb \
            ${LAYERDIR}/recipes-*/*/*.bbappend"

BBFILE_COLLECTIONS += "meta-qlocky"

BBFILE_PATTERN_meta-qlocky = "^${LAYERDIR}/"
BBFILE_PRIORITY_meta-qlocky = "20"

LICENSE_FLAGS_ACCEPTED = "synaptics-killswitch"

# recipe appends for machine specific BSP layers
BBFILES_DYNAMIC += " \
    raspberrypi:${LAYERDIR}/dynamic-layers/raspberrypi/recipes*/*/*.bb \
    raspberrypi:${LAYERDIR}/dynamic-layers/raspberrypi/recipes*/*/*.bbappend \
"

LAYERSERIES_COMPAT_meta-qlocky = "scarthgap"

# Variable to this configuration layer folder
QLOCKY_CONF_DIR := "${@os.path.abspath(os.path.dirname(d.getVar('FILE', True)))}"
```
